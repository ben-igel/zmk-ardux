## config/boards/shields/pcbpb/Kconfig.defconfig
```kconfig
if SHIELD_PCBPB_LEFT
config ZMK_KEYBOARD_NAME
	default "pcbpb L"

endif

if SHIELD_PCBPB_RIGHT
config ZMK_KEYBOARD_NAME
	default "pcbpb R"
```

## config/boards/shields/pcbpb/Kconfig.shield
```kconfig
config SHIELD_PCBPB_LEFT
	def_bool $(shields_list_contains,pcbpb_left)

config SHIELD_PCBPB_RIGHT
	def_bool $(shields_list_contains,pcbpb_right)
```
