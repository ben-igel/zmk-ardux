## config/boards/shields/mini/Kconfig.defconfig
```kconfig
if SHIELD_MINI_LEFT
config ZMK_KEYBOARD_NAME
	default "minipb"

endif

if SHIELD_MINI_RIGHT
config ZMK_KEYBOARD_NAME
	default "minipb"

endif
```

## config/boards/shields/mini/Kconfig.shield
```kconfig
config SHIELD_MINI_LEFT
	def_bool $(shields_list_contains,mini_left)

config SHIELD_MINI_RIGHT
	def_bool $(shields_list_contains,mini_right)
```

## config/boards/shields/the_paintbrush/Kconfig.defconfig
```kconfig
if SHIELD_THE_PAINTBRUSH_LEFT
config ZMK_KEYBOARD_NAME
	default "Paintbrush L"

endif

if SHIELD_THE_PAINTBRUSH_RIGHT
config ZMK_KEYBOARD_NAME
	default "Paintbrush R"

endif
```

## config/west.yml
```yaml
manifest:
  remotes:
    - name: zmkfirmware
      url-base: https://github.com/Percentnineteen/zmk.git
    - name: zmk-ardux
      url-base: https://github.com/arduxio
  projects:
    - name: zmk
      remote: zmkfirmware
      revision: advertise_profile
      import: app/west.yml
  self:
    path: config
```
